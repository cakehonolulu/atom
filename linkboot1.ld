ENTRY(boot1)

OUTPUT_FORMAT("binary")

OUTPUT_ARCH(i386)

SECTIONS {

    .text :
    {
        *(.text)
    }

    .rodata :
    {
        *(.rodata)
    }

    .data :
    {
        *(.data)
    }

    .bss :
    {
        *(.bss)
    }
}