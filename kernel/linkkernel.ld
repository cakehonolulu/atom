ENTRY(_start)

OUTPUT_FORMAT("binary")

OUTPUT_ARCH(i386)

SECTIONS {

	. = 1M;

    .text :
    {
        *(.text)
    }

    .rodata :
    {
        *(.rodata)
    }

    .data :
    {
        *(.data)
    }

    .bss :
    {
        *(COMMON)
        *(.bss)
    }
}